## Kconfig
```kconfig
config ZMK_HUD_TELEMETRY
    bool "Stream keyboard state telemetry to a host HUD"
    default n
    help
      Subscribes to ZMK events on the central and emits newline-delimited
      JSON telemetry over the enabled transports.

if ZMK_HUD_TELEMETRY

config ZMK_HUD_TELEMETRY_USB
    bool "Emit telemetry over a USB CDC-ACM serial port"
    default y
    select SERIAL
    select UART_LINE_CTRL
    select USB_DEVICE_STACK
    select USB_CDC_ACM

config ZMK_HUD_TELEMETRY_BLE
    bool "Emit telemetry over a custom BLE GATT notify characteristic"
    default y
    depends on ZMK_BLE

config ZMK_HUD_TELEMETRY_LINE_MAX
    int "Max telemetry line length (bytes)"
    default 160
    help
      Must fit the longest line. `bind` lines (behavior name + two 32-bit
      params) and `klyr` lines (layer display-name) are the longest.

config ZMK_HUD_TELEMETRY_KEY_COUNT
    int "Number of key positions per layer"
    default 60
    help
      Positions dumped per layer in the keymap stream (0..count-1). ZMK has no
      public runtime macro for this in v0.3.0, so set it to the keyboard's
      physical key count (handwired_split = 60).

config ZMK_HUD_TELEMETRY_KEYMAP_POLL_MS
    int "Keymap change-detection poll interval (ms, 0 = disabled)"
    default 2000
    help
      ZMK raises no event when a binding changes (e.g. via ZMK Studio), so the
      module periodically checksums the runtime keymap and re-streams it when it
      changes. 0 disables polling (keymap is then only sent on connect).

endif
```
